## boards/stm32u575vgtx_custom/Kconfig.stm32u575vgtx_custom
```kconfig
# Copyright (c) 2021 Linaro Limited
# SPDX-License-Identifier: Apache-2.0

config BOARD_STM32U575VGTX_CUSTOM
	select SOC_STM32U575XX
```

## boards/stm32u575vgtx_custom/board.yml
```yaml
board:
  name: stm32u575vgtx_custom
  vendor: st
  socs:
    - name: stm32u575xx
```
